## configs/sbg3300_port_defconfig
```kconfig
CONFIG_TARGET_bmips=y
CONFIG_TARGET_bmips_bcm63268=y
CONFIG_TARGET_bmips_bcm63268_DEVICE_zyxel_sbg3300-n000=y
CONFIG_TARGET_INITRAMFS_COMPRESSION_NONE=y
CONFIG_TARGET_ROOTFS_INITRAMFS=y
```
